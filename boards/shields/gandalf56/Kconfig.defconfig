## boards/shields/gandalf56/Kconfig.defconfig
```kconfig
# Copyright (c) 2025 The ZMK Contributors
# SPDX-License-Identifier: MIT

if SHIELD_GANDALF56

config ZMK_KEYBOARD_NAME
    default "Gandalf56"
    
endif
```

## boards/shields/gandalf56/Kconfig.shield
```kconfig
# Copyright (c) 2020 The ZMK Contributors
# SPDX-License-Identifier: MIT

config SHIELD_GANDALF56
    def_bool $(shields_list_contains,gandalf56)
```
